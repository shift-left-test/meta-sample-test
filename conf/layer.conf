## conf/layer.conf
```bitbake
BBPATH =. "${LAYERDIR}:"

BBFILES += " \
    ${LAYERDIR}/recipes-*/*/*.bb \
    ${LAYERDIR}/recipes-*/*/*.bbappend \
"

BBFILE_COLLECTIONS += "meta-sample-test"
BBFILE_PATTERN_meta-sample-test = "^${LAYERDIR}/"
BBFILE_PRIORITY_meta-sample-test = "83"

LAYERDEPENDS_meta-sample-test = "core meta-shift meta-sample"
LAYERSERIES_COMPAT_meta-sample-test = "jethro krogoth morty pyro rocko sumo thud warrior zeus dunfell gatesgarth hardknott honister"
```
